## ToDo/processandmemory/31 - Process and Memory/2/process_and_memory-master/linux-root/kernel/process_and_memory/Kconfig
```kconfig
menu "Process and Memory"

config SYSCALL_PROCESS_AND_MEMORY
	bool "Enables the syscall for the Process and Memory project"
	default y

endmenu
```
